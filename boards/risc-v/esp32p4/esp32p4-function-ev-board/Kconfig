## boards/risc-v/esp32p4/esp32p4-function-ev-board/Kconfig
```kconfig
#
# For a description of the syntax of this configuration file,
# see the file kconfig-language.txt in the NuttX tools repository.
#

if ARCH_BOARD_ESP32P4_FUNCTION_EV_BOARD

config ESP32P4_FUNCTION_EV_BOARD_LCD
	bool "EK79007 MIPI-DSI LCD and /dev/fb0"
	depends on ESPRESSIF_SPIRAM
	select BOARD_EARLY_INITIALIZE
	select ESPRESSIF_MIPI_DSI
	select VIDEO_FB
	select FB_UPDATE
	---help---
		Initialize the Function EV Board 7-inch 1024x600 EK79007 panel,
		allocate an RGB565 framebuffer from PSRAM, expose /dev/fb0, and
		show a rainbow test pattern during board bring-up.

		This deliberately does not enable touch or a GUI framework.

config ESP32P4_FUNCTION_EV_BOARD_TOUCHSCREEN
	bool "GT911 capacitive touchscreen and /dev/input0"
	depends on ESP32P4_FUNCTION_EV_BOARD_LCD
	select ESPRESSIF_I2C0
	select INPUT
	select INPUT_GT9XX
	---help---
		Register the 7-inch panel's GT911 controller on I2C0 as
		/dev/input0.  The GUI polls the device, matching the vendor BSP.

config ESP32P4_FUNCTION_EV_BOARD_CAMERA
	bool "SC2336 MIPI-CSI camera and /dev/video0"
	depends on ESP32P4_FUNCTION_EV_BOARD_LCD
	select BOARD_EARLY_INITIALIZE
	select ESPRESSIF_I2C0
	select ESPRESSIF_LDO
	select VIDEO
	select VIDEO_STREAM
	---help---
		Register the Function EV Board SC2336 camera through the NuttX
		V4L2 capture driver as /dev/video0. The sensor uses I2C0 GPIO7/8
		and the MIPI CSI/ISP pipeline converts RAW10 to RGB565.

endif # ARCH_BOARD_ESP32P4_FUNCTION_EV_BOARD
```
